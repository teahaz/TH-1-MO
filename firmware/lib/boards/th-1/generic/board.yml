## firmware/lib/boards/th-1/generic/board.yml
```yaml
board:
  name: generic
  full_name: teahaz TH-1 generic nRF52840
  vendor: th-1
  socs:
  - name: nrf52840
```

## firmware/lib/boards/th-1/mo/board.yml
```yaml
board:
  name: mo
  full_name: teahaz TH-1/MO co processor
  vendor: th-1
  socs:
  - name: nrf52840
  revision:
    format: major.minor.patch
    default: "0.1.0"
    revisions:
    - name: "0.1.0"
```
